## conf/machine/pine64-plus.conf
```bitbake
#
# Jailhouse, a Linux-based partitioning hypervisor
#
# Copyright (c) Vijai Kumar K, 2020
#
# Authors:
#  Vijai Kumar K <vijaikumar.kanagarajan@gmail.com>
#
# SPDX-License-Identifier: MIT
#

DISTRO_ARCH = "arm64"

IMAGE_TYPE = "wic-img"
IMAGER_INSTALL += "u-boot-sunxi"

IMAGE_INSTALL += "u-boot-script"
```

## wic/pine64-plus.wks
```
#
# Jailhouse, a Linux-based partitioning hypervisor
#
# Copyright (c) Vijai Kumar K, 2020
#
# Authors:
#  Vijai Kumar K <vijaikumar.kanagarajan@gmail.com>
#
# SPDX-License-Identifier: MIT
#

part u-boot --source rawcopy --sourceparams "file=/usr/lib/u-boot/pine64_plus/sunxi-spl.bin" --no-table --align 8

part / --source rootfs-u-boot --ondisk mmcblk0 --fstype ext4 --label platform --align 1024 --sourceparams "no_initrd=yes,script_prepend=setenv fdt_high 0xffffffff"

bootloader --append "mem=128M vmalloc=512M"
```
